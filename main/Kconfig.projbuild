## main/Kconfig.projbuild
```kconfig
menu "ESP32S3 MODBUS Gateway Configuration"

    config MODBUS_GW_WIFI_SSID
        string "Default WiFi SSID"
        default ""
        help
            Default STA WiFi SSID (empty = no default, use AP mode).

    config MODBUS_GW_DEVICE_NAME
        string "Device Name"
        default "esp32s3_modbus"
        help
            Device name used in MQTT topics.

    config MODBUS_GW_MQTT_URI
        string "Default MQTT Broker URI"
        default "mqtt://test.mosquitto.org"
        help
            Default MQTT broker URI (e.g. mqtt://192.168.1.100).

    config MODBUS_GW_UART_TX
        int "Default UART TX GPIO"
        default 16
        range 0 48
        help
            UART TX pin for MODBUS RS485 communication.

    config MODBUS_GW_UART_RX
        int "Default UART RX GPIO"
        default 17
        range 0 48
        help
            UART RX pin for MODBUS RS485 communication.

    config MODBUS_GW_UART_DE
        int "Default DE/RE GPIO"
        default 8
        range -1 48
        help
            RS485 DE/RE direction control pin. Set -1 to disable.

    config MODBUS_GW_OTA_ALLOW_HTTP
        bool "Allow HTTP for OTA firmware download"
        default y
        help
            If enabled, OTA firmware updates can use plain HTTP URLs
            (in addition to HTTPS).  Disable to require HTTPS; this
            needs valid CA certificates bundled or firmware signing.

    config MODBUS_GW_OTA_DEFAULT_URL
        string "Default OTA firmware URL"
        default ""
        help
            Optional default URL for OTA firmware updates.  This can
            be overridden at runtime by publishing to the {dev}/ota
            MQTT topic with payload {"url":"https://..."}.

endmenu
```

## sdkconfig.defaults
```kconfig
# ESP32S3 target
CONFIG_IDF_TARGET="esp32s3"

# CPU
CONFIG_ESP32S3_DEFAULT_CPU_FREQ_240=y
CONFIG_ESP32S3_DEFAULT_CPU_FREQ_MHZ=240
CONFIG_ESP32S3_SPIRAM_SUPPORT=y

# SPIRAM (OCT = 8-line, fastest)
CONFIG_SPIRAM_MODE_OCT=y
CONFIG_SPIRAM_SPEED_80M=y
CONFIG_SPIRAM_USE_MALLOC=y
CONFIG_SPIRAM_ALLOW_BSS_SEG_EXTERNAL_MEMORY=y

# Flash (16MB QIO @ 80MHz)
CONFIG_ESPTOOLPY_FLASHSIZE_16MB=y
CONFIG_ESPTOOLPY_FLASHSIZE="16MB"
CONFIG_ESPTOOLPY_FLASHMODE_QIO=y
CONFIG_ESPTOOLPY_FLASHFREQ_80M=y
CONFIG_PARTITION_TABLE_CUSTOM=y
CONFIG_PARTITION_TABLE_CUSTOM_FILENAME="partitions.csv"

# Bootloader (OTA rollback support)
CONFIG_BOOTLOADER_APP_ROLLBACK_ENABLE=y
CONFIG_BOOTLOADER_COMPILER_OPTIMIZATION_SIZE=y
CONFIG_BOOTLOADER_LOG_LEVEL_WARN=y

# OTA
CONFIG_OTA_ALLOW_HTTP=y

# Compiler
CONFIG_COMPILER_OPTIMIZATION_SIZE=y
CONFIG_NEWLIB_NANO_FORMAT=y

# FreeRTOS
CONFIG_FREERTOS_HZ=1000

# WiFi
CONFIG_ESP_WIFI_STATIC_RX_BUFFER_NUM=8
CONFIG_ESP_WIFI_DYNAMIC_RX_BUFFER_NUM=32
CONFIG_ESP_WIFI_TX_BUFFER_TYPE=0

# LWIP
CONFIG_LWIP_LOCAL_HOSTNAME="esp32s3_modbus"
CONFIG_LWIP_MAX_SOCKETS=16

# MQTT
CONFIG_MQTT_OUTBOX_EXPIRED_TIMEOUT_MS=30000

# UART

# Log level (reduce in production)
CONFIG_LOG_DEFAULT_LEVEL_INFO=y
CONFIG_LOG_MAXIMUM_LEVEL_DEBUG=y

# Project-specific defaults (MODBUS Gateway)
CONFIG_MODBUS_GW_WIFI_SSID=""
CONFIG_MODBUS_GW_DEVICE_NAME="esp32s3_modbus"
CONFIG_MODBUS_GW_MQTT_URI="mqtt://test.mosquitto.org"
CONFIG_MODBUS_GW_UART_TX=16
CONFIG_MODBUS_GW_UART_RX=17
CONFIG_MODBUS_GW_UART_DE=8
```
