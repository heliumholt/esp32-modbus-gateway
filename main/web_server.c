#include <stdio.h>
#include <string.h>
#include "freertos/FreeRTOS.h"
#include "freertos/task.h"
#include "esp_log.h"
#include "esp_http_server.h"
#include "cJSON.h"
#include "web_server.h"
#include "nvs_config.h"
#include "wifi_manager.h"
#include "dns_responder.h"
#include "modbus_params.h"
#include "esp_timer.h"

static const char *TAG = "web_srv";

static httpd_handle_t s_server = NULL;

/* External embedded HTML file (generated by EMBED_FILES) */
extern const uint8_t web_config_html_start[] asm("_binary_web_config_html_start");
extern const uint8_t web_config_html_end[] asm("_binary_web_config_html_end");

/* ================================================================
 * URI Handlers
 * ================================================================ */

/* GET / — serve the config HTML page */
static esp_err_t handle_get_root(httpd_req_t *req)
{
    size_t html_len = web_config_html_end - web_config_html_start;
    httpd_resp_set_type(req, "text/html; charset=utf-8");
    httpd_resp_send(req, (const char *)web_config_html_start, html_len);
    return ESP_OK;
}

/* GET /api/config — return current config as JSON */
static esp_err_t handle_get_config(httpd_req_t *req)
{
    const config_t *cfg = nvs_config_get();
    cJSON *root = cJSON_CreateObject();

    cJSON_AddStringToObject(root, "dev_name",   cfg->dev_name);
    cJSON_AddStringToObject(root, "wifi_ssid",  cfg->wifi_ssid);
    cJSON_AddStringToObject(root, "wifi_pass",  "****");  /* mask password */
    cJSON_AddNumberToObject(root, "ap_fallback", cfg->ap_fallback);
    cJSON_AddStringToObject(root, "mqtt_uri",   cfg->mqtt_uri);
    cJSON_AddNumberToObject(root, "mqtt_port",  cfg->mqtt_port);
    cJSON_AddStringToObject(root, "mqtt_user",  cfg->mqtt_user);
    cJSON_AddStringToObject(root, "mqtt_pass",  "****");
    cJSON_AddStringToObject(root, "mqtt_client_id", cfg->mqtt_client_id);
    cJSON_AddStringToObject(root, "mqtt_data_t", cfg->mqtt_data_t);
    cJSON_AddStringToObject(root, "mqtt_write_t", cfg->mqtt_write_t);
    cJSON_AddStringToObject(root, "mqtt_stat_t", cfg->mqtt_stat_t);
    cJSON_AddNumberToObject(root, "baudrate",   cfg->baudrate);
    cJSON_AddNumberToObject(root, "data_bits",  cfg->data_bits);
    cJSON_AddNumberToObject(root, "stop_bits",  cfg->stop_bits);
    cJSON_AddNumberToObject(root, "parity",     cfg->parity);
    cJSON_AddStringToObject(root, "reg_list",   cfg->reg_list);
    cJSON_AddNumberToObject(root, "tx_pin",     cfg->tx_pin);
    cJSON_AddNumberToObject(root, "rx_pin",     cfg->rx_pin);
    cJSON_AddNumberToObject(root, "de_pin",     cfg->de_pin);
    cJSON_AddNumberToObject(root, "poll_intv",  cfg->poll_intv);
    cJSON_AddStringToObject(root, "custom1",    cfg->custom1);
    cJSON_AddStringToObject(root, "custom2",    cfg->custom2);
    cJSON_AddStringToObject(root, "custom3",    cfg->custom3);

    char *json_str = cJSON_PrintUnformatted(root);
    cJSON_Delete(root);
    if (!json_str) {
        ESP_LOGE(TAG, "Failed to serialize config JSON (OOM)");
        httpd_resp_send_500(req);
        return ESP_FAIL;
    }
    httpd_resp_set_type(req, "application/json");
    httpd_resp_send(req, json_str, strlen(json_str));
    cJSON_free(json_str);
    return ESP_OK;
}

/* GET /api/payload-preview — generate sample MQTT payload */
static esp_err_t handle_payload_preview(httpd_req_t *req)
{
    const config_t *cfg = nvs_config_get();

    /* Resolve topic: replace {dev} with device name */
    char topic[128];
    const char *tpl = cfg->mqtt_data_t;
    char *dst = topic;
    const char *end = topic + sizeof(topic) - 1;
    while (*tpl && dst < end) {
        if (strncmp(tpl, "{dev}", 5) == 0) {
            size_t n = strlen(cfg->dev_name);
            if (dst + n > end) n = end - dst;
            memcpy(dst, cfg->dev_name, n);
            dst += n;
            tpl += 5;
        } else {
            *dst++ = *tpl++;
        }
    }
    *dst = '\0';

    cJSON *root = cJSON_CreateObject();
    cJSON_AddStringToObject(root, "topic", topic);

    /* Build sample payload */
    cJSON *payload = cJSON_CreateObject();
    cJSON_AddNumberToObject(payload, "ts", (double)(esp_timer_get_time() / 1000));

    /* Parse register list and add sample entries */
    cJSON *regs = cJSON_CreateObject();
    if (strlen(cfg->reg_list) > 0) {
        register_entry_t entries[MODBUS_MAX_ENTRIES];
        int count = modbus_params_parse(cfg->reg_list, entries, MODBUS_MAX_ENTRIES);
        for (int i = 0; i < count && i < MODBUS_MAX_ENTRIES; i++) {
            for (int j = 0; j < entries[i].count && j < 8; j++) {  /* limit 8 per group */
                char key[32];
                snprintf(key, sizeof(key), "s%d:%d",
                         entries[i].slave_addr,
                         entries[i].start_reg + j);
                /* Use placeholder values: sequential starting from reg address */
                cJSON_AddNumberToObject(regs, key, (double)(entries[i].start_reg + j + 1000));
            }
            if (entries[i].count > 8) {
                char key[32];
                snprintf(key, sizeof(key), "s%d:...(+%d more)",
                         entries[i].slave_addr,
                         entries[i].count - 8);
                cJSON_AddStringToObject(regs, key, "...");
            }
        }
    } else {
        /* No reg_list configured — show example */
        cJSON_AddNumberToObject(regs, "s1:30001", 31001);
        cJSON_AddNumberToObject(regs, "s1:30002", 31002);
        cJSON_AddNumberToObject(regs, "s1:30003", 31003);
    }
    cJSON_AddItemToObject(payload, "regs", regs);
    cJSON_AddItemToObject(root, "payload", payload);

    char *json_str = cJSON_Print(root);  /* pretty-print for readability */
    cJSON_Delete(root);
    if (!json_str) {
        ESP_LOGE(TAG, "Failed to serialize payload preview (OOM)");
        httpd_resp_send_500(req);
        return ESP_FAIL;
    }
    httpd_resp_set_type(req, "application/json");
    httpd_resp_send(req, json_str, strlen(json_str));
    cJSON_free(json_str);
    return ESP_OK;
}

/* POST /save — parse form data and write to NVS */
static esp_err_t handle_post_save(httpd_req_t *req)
{
    char buf[2048] = {0};
    int ret = httpd_req_recv(req, buf, sizeof(buf) - 1);
    if (ret <= 0) {
        httpd_resp_send_err(req, HTTPD_400_BAD_REQUEST, "Empty body");
        return ESP_FAIL;
    }

    ESP_LOGI(TAG, "POST /save body: %s", buf);

    /* Parse URL-encoded form data: key1=val1&key2=val2... */
    nvs_config_lock();
    char *saveptr = NULL;
    char *pair = strtok_r(buf, "&", &saveptr);
    while (pair) {
        char *eq = strchr(pair, '=');
        if (eq) {
            *eq = '\0';
            char *key = pair;
            char *val = eq + 1;

            /* URL-decode: + → space, %XX → byte */
            char *src = val;
            char *dst = val;
            while (*src) {
                if (*src == '+') {
                    *dst++ = ' ';
                    src++;
                } else if (*src == '%' && src[1] && src[2]) {
                    char hex[3] = {src[1], src[2], '\0'};
                    *dst++ = (char)strtol(hex, NULL, 16);
                    src += 3;
                } else {
                    *dst++ = *src++;
                }
            }
            *dst = '\0';

            /* Try string setter first — handles all text fields */
            esp_err_t serr = nvs_config_set_string(key, val);

            /* If not a string field, try numeric setters */
            if (serr == ESP_ERR_NOT_FOUND) {
                char *endptr;
                long num = strtol(val, &endptr, 10);
                if (*endptr == '\0' && val[0] != '\0') {
                    nvs_config_set_u32(key, (uint32_t)num);
                    nvs_config_set_u16(key, (uint16_t)num);
                    nvs_config_set_u8(key, (uint8_t)num);
                }
            }
        }
        pair = strtok_r(NULL, "&", &saveptr);
    }

    /* Persist to NVS */
    nvs_config_save();
    nvs_config_unlock();

    /* Signal WiFi manager to switch modes */
    wifi_manager_on_config_saved();

    /* Respond success */
    httpd_resp_set_type(req, "application/json");
    httpd_resp_sendstr(req, "{\"status\":\"ok\"}");
    return ESP_OK;
}

/* Catch-all handler — redirect to / for captive portal */
static esp_err_t handle_captive_redirect(httpd_req_t *req)
{
    httpd_resp_set_status(req, "302 Found");
    httpd_resp_set_hdr(req, "Location", "http://192.168.4.1/");
    httpd_resp_send(req, NULL, 0);
    return ESP_OK;
}

/* ================================================================
 * Public
 * ================================================================ */

void web_server_start(void)
{
    if (s_server) return;  /* already running */

    httpd_config_t config = HTTPD_DEFAULT_CONFIG();
    config.max_uri_handlers = 16;
    config.lru_purge_enable = true;
    config.stack_size = 8192;

    if (httpd_start(&s_server, &config) == ESP_OK) {
        ESP_LOGI(TAG, "HTTP server started on port 80");

        /* Register URI handlers */
        httpd_uri_t uri_root = {
            .uri = "/",
            .method = HTTP_GET,
            .handler = handle_get_root,
            .user_ctx = NULL,
        };
        httpd_register_uri_handler(s_server, &uri_root);

        httpd_uri_t uri_config = {
            .uri = "/api/config",
            .method = HTTP_GET,
            .handler = handle_get_config,
            .user_ctx = NULL,
        };
        httpd_register_uri_handler(s_server, &uri_config);

        httpd_uri_t uri_preview = {
            .uri = "/api/payload-preview",
            .method = HTTP_GET,
            .handler = handle_payload_preview,
            .user_ctx = NULL,
        };
        httpd_register_uri_handler(s_server, &uri_preview);

        httpd_uri_t uri_save = {
            .uri = "/save",
            .method = HTTP_POST,
            .handler = handle_post_save,
            .user_ctx = NULL,
        };
        httpd_register_uri_handler(s_server, &uri_save);

        /* Captive portal catch-all — must be registered LAST */
        httpd_uri_t uri_captive = {
            .uri = "/*",
            .method = HTTP_GET,
            .handler = handle_captive_redirect,
        };
        httpd_register_uri_handler(s_server, &uri_captive);

        /* Start DNS responder */
        dns_server_start();
    } else {
        ESP_LOGE(TAG, "Failed to start HTTP server");
    }
}

void web_server_stop(void)
{
    dns_server_stop();
    if (s_server) {
        httpd_stop(s_server);
        s_server = NULL;
        ESP_LOGI(TAG, "HTTP server stopped");
    }
}
